## MiddleStation/tools4nrf5340/hci_rpmsg/Kconfig/Kconfig.shield
```kconfig
osource "C:/Users/Jacob/ncs/v1.5.0/nrf/boards/shields/*/Kconfig.shield"
osource "C:/Users/Jacob/ncs/v1.5.0/zephyr/boards/shields/*/Kconfig.shield"
osource "C:/Users/Jacob/ncs/v1.5.0/zephyr/boards/shields/*/Kconfig.shield"
```

## MiddleStation/tools4nrf5340/hci_rpmsg/Kconfig/Kconfig.shield.defconfig
```kconfig
osource "C:/Users/Jacob/ncs/v1.5.0/nrf/boards/shields/*/Kconfig.defconfig"
osource "C:/Users/Jacob/ncs/v1.5.0/zephyr/boards/shields/*/Kconfig.defconfig"
osource "C:/Users/Jacob/ncs/v1.5.0/zephyr/boards/shields/*/Kconfig.defconfig"
```

## MiddleStation/tools4nrf5340/hci_rpmsg/Kconfig/Kconfig.soc.arch
```kconfig
osource "C:/Users/Jacob/ncs/v1.5.0/zephyr/soc/$(ARCH)/Kconfig"
osource "C:/Users/Jacob/ncs/v1.5.0/zephyr/soc/$(ARCH)/*/Kconfig"
```
