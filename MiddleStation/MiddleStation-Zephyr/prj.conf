## CMakeLists.txt
```
#
# Copyright (c) 2020 Nordic Semiconductor
#
# SPDX-License-Identifier: LicenseRef-Nordic-5-Clause
#
cmake_minimum_required(VERSION 3.13.1)

find_package(Zephyr REQUIRED HINTS $ENV{ZEPHYR_BASE})
project(NONE)

# NORDIC SDK APP START
target_sources(app PRIVATE
  src/main.c
  src/main.h
  src/ble_comms.h
  src/conn_queue.h
  src/conn_queue.c
  src/ble_comms.c
  src/device_record.h
  src/device_record.c)
# NORDIC SDK APP END
zephyr_library_include_directories(.)
```

## prj.conf
```kconfig
#
# Copyright (c) 2020 Nordic Semiconductor
#
# SPDX-License-Identifier: LicenseRef-Nordic-5-Clause
#
CONFIG_REBOOT=y
CONFIG_DK_LIBRARY=y

CONFIG_BT=y
CONFIG_BT_CENTRAL=y
CONFIG_BT_GATT_CLIENT=y
CONFIG_BT_MAX_CONN=16
CONFIG_BT_GATT_DM=y
CONFIG_HEAP_MEM_POOL_SIZE=4096
CONFIG_BT_RX_STACK_SIZE=2048
CONFIG_BT_DEBUG_LOG=y
#CONFIG_BT_SMP=y
#CONFIG_BT_DEBUG_CONN=y
CONFIG_BT_GATT_DM_DATA_PRINT=y
CONFIG_DEBUG=y
CONFIG_DEBUG_INFO=y
#CONFIG_ASSERT=y
#CONFIG_ASSERT_VERBOSE=y

CONFIG_ENTROPY_GENERATOR=y
CONFIG_ENTROPY_DEVICE_RANDOM_GENERATOR=y

#CONFIG_THREAD_ANALYZER=y
#CONFIG_THREAD_ANALYZER_USE_PRINTK=y
#CONFIG_THREAD_NAME=y
#CONFIG_THREAD_ANALYZER_AUTO=y
#CONFIG_THREAD_ANALYZER_AUTO_INTERVAL=5
#CONFIG_THREAD_ANALYZER_LOG_LEVEL_DBG=y
#CONFIG_STACK_USAGE=y
```

## src/main.c
```c
#include "main.h"

// Using the Marco K_THREAD_DEFINE to define a Thread to handle the Bluetooth connections
extern void conn_process(void);
K_THREAD_DEFINE(conn_process_thread,
	1024,
	conn_process,
	NULL,
	NULL,
	NULL,
	10,
	0,
	0);

void main(void)
{
	k_mutex_init(&discovering);
	k_condvar_init(&wait_discovering_complete);
	k_sem_init(&gatt_read_sem, 0, 1);
	ble_comms_start();
}

void conn_process() {
	while (1) {
		if (IsEmptyQueue(&ConnPQ) == 0) {
//			ConnPQNode *pNode = (ConnPQNode *)k_calloc(1, sizeof(ConnPQNode));
//			DeQueue(&ConnPQ, pNode);
//			struct bt_conn *curr_conn = bt_conn_lookup_addr_le(BT_ID_DEFAULT, &pNode->addr);
//			bt_conn_disconnect(curr_conn, BT_HCI_ERR_REMOTE_USER_TERM_CONN);
//			
//			bt_conn_unref(curr_conn);
//			curr_conn = NULL;
//			k_free(pNode);
//			pNode = NULL;
			ConnPQNode *pNode = (ConnPQNode *)k_calloc(1, sizeof(ConnPQNode));
			DeQueue(&ConnPQ, pNode);
			char addr_str[BT_ADDR_LE_STR_LEN];
			bt_addr_le_to_str(&pNode->addr, addr_str, sizeof(addr_str));
			printk("Handling connection from %s\n", addr_str);
			
			struct bt_conn *curr_conn = bt_conn_lookup_addr_le(BT_ID_DEFAULT, &pNode->addr);

			if (curr_conn != NULL)
			{
				bt_conn_unref(curr_conn);
				
				printk("start bas disc\n");
				
				// start to discover bas service & read battery level
				k_mutex_lock(&discovering, K_MINUTES(1));
				int err = bt_gatt_dm_start(curr_conn, BAT_SERV_UUID, &discover_all_cb, NULL);
				if (err) {
					printk("Failed to start discovery (err %d)\n", err);
					bt_conn_disconnect(curr_conn, BT_HCI_ERR_REMOTE_USER_TERM_CONN);
				}
				else {

					k_condvar_wait(&wait_discovering_complete, &discovering, K_SECONDS(30));

					//k_sleep(K_MSEC(500));
				}
				k_mutex_unlock(&discovering);
				
				
				printk("start sound disc\n");
				
				k_mutex_lock(&discovering, K_MINUTES(1));
				err = bt_gatt_dm_start(curr_conn, SOUND_SERV_UUID, &discover_all_cb, NULL);
				if (err) {
					printk("Failed to start discovery (err %d)\n", err);
					bt_conn_disconnect(curr_conn, BT_HCI_ERR_REMOTE_USER_TERM_CONN);
				}
				else {

					k_condvar_wait(&wait_discovering_complete, &discovering, K_SECONDS(30));

					//k_sleep(K_MSEC(500));
				}
				k_mutex_unlock(&discovering);


			}
			k_free(pNode);
			pNode = NULL;
		}
		// to avoid blocking other threads
		k_sleep(K_MSEC(10));
	}
}
```

## src/ble_comms.c
```c
#include "ble_comms.h"

ConnPQueue ConnPQ;
ConnRec ConnRC;

struct k_mutex discovering;
struct k_condvar wait_discovering_complete;

struct k_sem gatt_read_sem;

struct bt_gatt_read_params gatt_read_params;
//struct bt_gatt_write_params gatt_write_params;

struct bt_conn *conn_connecting;
uint8_t conn_count;

uint8_t thingy_pattern[21] = { 0x02, 0x01, 0x06, 0x11, 0x06, 0x42, 0x00, 0x74, 0xa9, 0xff,
	0x52, 0x10, 0x9b, 0x33, 0x49, 0x35, 0x9b, 0x00, 0x01, 0x68, 0xef };

uint8_t SPEAKER_DATA[5] = { 0xDC, 0x03, 0x2C, 0x01, 0x64 };

static uint8_t gatt_char_read_cb(struct bt_conn *conn, uint8_t err, struct bt_gatt_read_params *params, const void *data, uint16_t length) {
	int key = irq_lock();
	uint8_t battery = 0;
	memcpy(&battery, data, 1);
	
	char addr_str[BT_ADDR_LE_STR_LEN];
	bt_addr_le_to_str(bt_conn_get_dst(conn), addr_str, sizeof(addr_str));
	printk("%s :", addr_str);
	
	printk("battery level is %d\n", battery);
	
	int record_index = searchAddr(&ConnRC, bt_conn_get_dst(conn));
	
	ConnRC.DevRec[record_index].battery_lvl = battery;
	
	irq_unlock(key);
	
	k_mutex_lock(&discovering, K_FOREVER);
	k_condvar_signal(&wait_discovering_complete);
	k_mutex_unlock(&discovering);
	
	return BT_GATT_ITER_STOP;
}
//static uint8_t gatt_char_write_cb(struct bt_conn *conn, uint8_t err, struct bt_gatt_write_params *params) {
//	return BT_GATT_ITER_STOP;
//}

static void discover_all_completed(struct bt_gatt_dm *dm, void *ctx)
{
	int key = irq_lock();
	char uuid_str[37];

	const struct bt_gatt_dm_attr *gatt_service_attr =
			bt_gatt_dm_service_get(dm);
	const struct bt_gatt_service_val *gatt_service =
			bt_gatt_dm_attr_service_val(gatt_service_attr);

	//size_t attr_count = bt_gatt_dm_attr_cnt(dm);

	bt_uuid_to_str(gatt_service->uuid, uuid_str, sizeof(uuid_str));

	struct bt_conn *conn = bt_gatt_dm_conn_get(dm);

	char addr_str[BT_ADDR_LE_STR_LEN];
	bt_addr_le_to_str(bt_conn_get_dst(conn), addr_str, sizeof(addr_str));
	printk("%s :", addr_str);
	printk("Found service %s\n", uuid_str);

	const struct bt_gatt_dm_attr *gatt_bas_attr = bt_gatt_dm_char_by_uuid(dm, BAT_LVL_CHAR_UUID);
	const struct bt_gatt_dm_attr *gatt_bas_desc = bt_gatt_dm_desc_by_uuid(dm, gatt_bas_attr, BAT_LVL_CHAR_UUID);
	if (gatt_bas_attr != NULL) {
		gatt_read_params.func = gatt_char_read_cb;
		gatt_read_params.handle_count = 1;
		gatt_read_params.single.handle = gatt_bas_desc->handle;
		gatt_read_params.single.offset = 0;
		bt_gatt_read(conn, &gatt_read_params);
		bt_gatt_dm_data_release(dm);
		irq_unlock(key);
		return;
	}
	
	const struct bt_gatt_dm_attr *gatt_speaker_attr = bt_gatt_dm_char_by_uuid(dm, SPEAKER_CHAR_UUID);
	const struct bt_gatt_dm_attr *gatt_speaker_desc = bt_gatt_dm_desc_by_uuid(dm, gatt_speaker_attr, SPEAKER_CHAR_UUID);
	if (gatt_speaker_attr != NULL) {

		int err = bt_gatt_write_without_response(conn, gatt_speaker_desc->handle, SPEAKER_DATA, sizeof(SPEAKER_DATA), false);
		
		if (!err)
		{
			printk("beep\n");
		}
		
		bt_conn_disconnect(conn, BT_HCI_ERR_REMOTE_USER_TERM_CONN);

		k_mutex_lock(&discovering, K_FOREVER);
		k_condvar_signal(&wait_discovering_complete);
		k_mutex_unlock(&discovering);
		
		//bt_gatt_dm_data_print(dm);
		bt_gatt_dm_data_release(dm);
		irq_unlock(key);
		return;
		
	}
	
	//printk("Attribute count: %d\n", attr_count);

	//bt_gatt_dm_data_print(dm);
	//bt_gatt_dm_data_release(dm);
	//bt_gatt_dm_continue(dm, NULL);
	irq_unlock(key);
}

static void discover_all_service_not_found(struct bt_conn *conn, void *ctx)
{
	printk("No more services\n");
	k_mutex_lock(&discovering, K_FOREVER);
	k_condvar_signal(&wait_discovering_complete);
	k_mutex_unlock(&discovering);
}

static void discover_all_error_found(struct bt_conn *conn, int err, void *ctx)
{
	printk("The discovery procedure failed, err %d\n", err);
	k_mutex_lock(&discovering, K_FOREVER);
	k_condvar_signal(&wait_discovering_complete);
	k_mutex_unlock(&discovering);
}

struct bt_gatt_dm_cb discover_all_cb = {
	.completed = discover_all_completed,
	.service_not_found = discover_all_service_not_found,
	.error_found = discover_all_error_found,
};

void device_found(const bt_addr_le_t *addr,
	int8_t rssi,
	uint8_t type,
	struct net_buf_simple *ad)
{
	// We're only interested in connectable events
	if(type != BT_GAP_ADV_TYPE_ADV_IND &&
		type != BT_GAP_ADV_TYPE_ADV_DIRECT_IND) {
		return;
	}
	uint8_t id[21];
	memcpy(id, ad->data, 21);

	struct bt_conn *conn = bt_conn_lookup_addr_le(BT_ID_DEFAULT, addr);
	// If it is not connected and its advertising packet has same pattern with Thingy52
	// This custom filter may be replaced by the built-in filter in the future 
    if(conn == NULL && memcmp(id, thingy_pattern, 21) == 0) { 
	//if (conn == NULL) { 
	    if (conn_connecting) {
			printk("wait for disconnecting\n");
			return;
		}
	    
	    char addr_str[BT_ADDR_LE_STR_LEN];
		bt_addr_le_to_str(addr, addr_str, sizeof(addr_str));
		printk("Device found: %s (RSSI %d)\n", addr_str, rssi);
	    
	    int key = irq_lock();
	    
	    DeviceRec new_rec;
	    bt_addr_le_copy(&new_rec.addr, addr);
	    new_rec.rssi = rssi;

		int64_t priority;
		int64_t last_time = getLastConnTimeStamp(&ConnRC, addr);
		int64_t curr_time = k_uptime_get();
		
		if(last_time == INT64_MIN) {
			// no record, should have high priority
			priority = INT64_MAX;
		}else {
			//has record, priority is (current time - last connection time)
			priority = curr_time - last_time;
		}
	    new_rec.priority = priority;
	    
		// drop the last connection if the queue is full and the priority is lower
		if(IsFullQueue(&ConnPQ) == 1 && ConnPQ.Rear->priority < priority) {
			ConnPQNode *curr = ConnPQ.Front;
			while (curr->Next != ConnPQ.Rear) {
				curr = curr->Next;
			}
			ConnPQNode *last = ConnPQ.Rear;
			ConnPQ.Rear = curr;
			ConnPQ.Rear->Next = NULL;
			
			// disconnect the last connection based on the bt_addr_le_t addr
			struct bt_conn *old_conn = bt_conn_lookup_addr_le(BT_ID_DEFAULT, &last->addr);
			if(old_conn != NULL)
			{
				bt_conn_disconnect(old_conn, BT_HCI_ERR_REMOTE_USER_TERM_CONN);
				bt_conn_unref(old_conn);
			}
			k_free(last);
			last = NULL;
		}
	    
	    irq_unlock(key);
	    // stop scan; prepare for connecting
	    if(bt_le_scan_stop()) {
		    return;
	    }
	    // try to create the connection
	    int err = bt_conn_le_create(addr,
			BT_CONN_LE_CREATE_CONN,
			BT_LE_CONN_PARAM_DEFAULT,
			&conn_connecting);
	    
	    // error handling
	    if (err) {
		    printk("Create conn to %s failed (%d)\n", addr_str, err);
		    start_scan();
		    // Record the device but it is not connected
		    new_rec.last_conn_timestamp = INT64_MIN;
	    }
	    insertRec(&ConnRC, new_rec);
	}
	
	if(conn != NULL){
		bt_conn_unref(conn);
	}
}

void start_scan(void)
{
	int err;
	struct bt_le_scan_param scan_param = {
		.type = BT_LE_SCAN_TYPE_PASSIVE,
		.options = BT_LE_SCAN_OPT_NONE,
		.interval = BT_GAP_SCAN_FAST_INTERVAL,
		.window = BT_GAP_SCAN_FAST_WINDOW,
	};
	err = bt_le_scan_start(&scan_param, device_found);
	if (err) {
		printk("Scanning failed to start (err %d)\n", err);
		return;
	}

	printk("Scanning successfully started\n");
}

static void connected(struct bt_conn *conn, uint8_t err)
{
	int key = irq_lock();
	
	int record_index = searchAddr(&ConnRC, bt_conn_get_dst(conn));
	
	char addr[BT_ADDR_LE_STR_LEN];
	bt_addr_le_to_str(bt_conn_get_dst(conn), addr, sizeof(addr));
	if (err) {
		printk("Failed to connect to %s (%u)\n", addr, err);
		bt_conn_unref(conn_connecting);
		conn_connecting = NULL;
		start_scan();
		
		// Record the device but it is not connected
		ConnRC.DevRec[record_index].last_conn_timestamp = INT64_MIN;
		
		return;
	}
	
	
	conn_count++;

	if (conn_count < CONFIG_BT_MAX_CONN) {
		start_scan();
	}
	
	
	
	if (record_index != -1)
	{
		EnQueue(&ConnPQ, &ConnRC.DevRec[record_index].addr, ConnRC.DevRec[record_index].priority);
		
		bt_addr_le_to_str(&ConnRC.DevRec[record_index].addr, addr, sizeof(addr));
		printk("Connected (%u): %s priority %lld\n", conn_count, addr, ConnRC.DevRec[record_index].priority);		
	}
	else
	{
		printk("Didn't find the record! Must be disconnected");
		bt_conn_disconnect(conn, BT_HCI_ERR_REMOTE_USER_TERM_CONN);
	}

	conn_connecting = NULL;
	irq_unlock(key);

}

static void disconnected(struct bt_conn *conn, uint8_t reason)
{
	
	char addr[BT_ADDR_LE_STR_LEN];

	bt_addr_le_to_str(bt_conn_get_dst(conn), addr, sizeof(addr));

	bt_conn_unref(conn);
	
	int key = irq_lock();
	if (conn_count == CONFIG_BT_MAX_CONN) {
		start_scan();
	}

	conn_count--;
	
	int record_index = searchAddr(&ConnRC, bt_conn_get_dst(conn));
	ConnRC.DevRec[record_index].last_conn_timestamp = k_uptime_get();
	
	irq_unlock(key);

	printk("Disconnected (%u): %s (reason 0x%02x)\n", conn_count, addr, reason);

}

struct bt_conn_cb conn_callbacks = {
	.connected = connected,
	.disconnected = disconnected,
};

void ble_comms_start() {
	int err;
	err = bt_enable(NULL);
	if (err) {
		printk("Bluetooth init failed (err %d)\n", err);
		return;
	}

	printk("Bluetooth initialized\n");

	bt_conn_cb_register(&conn_callbacks);

	start_scan();

}
```

## src/ble_comms.h
```c
#ifndef _BLE_COMMS_H_
#define _BLE_COMMS_H_

#include <bluetooth/bluetooth.h>
#include <bluetooth/hci.h>
#include <bluetooth/conn.h>
#include <bluetooth/uuid.h>
#include <bluetooth/gatt.h>
#include <bluetooth/gatt_dm.h>

#include "conn_queue.h"
#include "device_record.h"

#define BAT_SERV_UUID BT_UUID_DECLARE_16(0x180F)
#define BAT_LVL_CHAR_UUID BT_UUID_DECLARE_16(0x2A19)

#define SOUND_SERV_UUID BT_UUID_DECLARE_128(BT_UUID_128_ENCODE(0xEF680500, 0x9B35, 0x4933, 0x9B10, 0x52FFA9740042))
#define SPEAKER_CHAR_UUID BT_UUID_DECLARE_128(BT_UUID_128_ENCODE(0xEF680502, 0x9B35, 0x4933, 0x9B10, 0x52FFA9740042))

void ble_comms_start();
void start_scan(void);
void device_found(const bt_addr_le_t *addr, int8_t rssi, uint8_t type, struct net_buf_simple *ad);

#endif
```

## src/conn_queue.c
```c
#include "conn_queue.h"
void InitQueue(ConnPQueue *queue){
	queue->Front = NULL;
	queue->Rear = NULL;
}

int IsEmptyQueue(ConnPQueue *queue) {
	int key = irq_lock();
    if (queue->Front == NULL) {
	    irq_unlock(key);
        return true;
    }
    else {
	    irq_unlock(key);
        return false;
    }
}

int IsFullQueue(ConnPQueue *queue) {
	int key = irq_lock();
	if(IsEmptyQueue(queue)){
		return false;
	}
	int i = 1;
	ConnPQNode *curr = queue->Front;
	while(curr->Next != NULL){
		curr = curr->Next;
		i++;
	}
	irq_unlock(key);
	if(i >= MAX_CONN_QUEUE_SIZE){
		return true;
	}
	return false;
}

//can assume the queue never exceed the max length
int EnQueue(ConnPQueue *queue, const bt_addr_le_t *addr, int64_t priority) {
	
	int key = irq_lock();
	
    ConnPQNode *p = (ConnPQNode *)k_calloc(1,sizeof(ConnPQNode));

    if (p != NULL) {

	    bt_addr_le_copy(&p->addr, addr);
		p->priority = priority;

		if(IsEmptyQueue(queue)){
			p->Next = NULL;
			queue->Front = p;
			queue->Rear = p;
			return true;
		}
		ConnPQNode *curr = queue->Front;
		ConnPQNode *prev = NULL;
		while(curr->Next != NULL){
			if(priority <= curr->priority){
				prev = curr;
				curr = curr->Next;
			}else{
				break;
			}
		}
		if(curr == queue->Front){
			p->Next = curr;
			queue->Front = p;
		}else if(curr == queue->Rear && priority <= curr->priority){
			p->Next = NULL;
			curr->Next = p;
			queue->Rear = p;
		}else{
			prev->Next = p;
			p->Next = curr;
		}
	    irq_unlock(key);
		return true;
    }else{
	    irq_unlock(key);
		return false;
	}
}

int DeQueue(ConnPQueue *queue, ConnPQNode *node) {
	int key = irq_lock();
    if (IsEmptyQueue(queue)!=1) {
		ConnPQNode *p = queue->Front;
	    // Assign connection info to ConnPQNode *node
	    bt_addr_le_copy(&node->addr, &p->addr);
	    node->priority = p->priority;
	    node->Next = NULL;
	    // Update the PQ
		queue->Front = queue->Front->Next;
	    // free the extracted node
		k_free(p);
		p = NULL;
	    irq_unlock(key);
		return true;
    }else{
	    irq_unlock(key);
		return false;
	}
}
```

## src/conn_queue.h
```c
#ifndef _CONN_QUEUE_
#define _CONN_QUEUE_
#define MAX_CONN_QUEUE_SIZE CONFIG_BT_MAX_CONN - 1
#include <power/reboot.h>
#include <zephyr.h>
#include "ble_comms.h"

typedef struct pq_conn_node {
	bt_addr_le_t addr;
	int64_t priority;
	struct pq_conn_node * Next;
}ConnPQNode;

typedef struct pq_conn {
	ConnPQNode *Front, *Rear;
}ConnPQueue;

void InitQueue(ConnPQueue *queue);
int IsEmptyQueue(ConnPQueue *queue);
int IsFullQueue(ConnPQueue *queue);
int EnQueue(ConnPQueue *queue, const bt_addr_le_t *addr, int64_t priority);
int DeQueue(ConnPQueue *queue, ConnPQNode *node);


#endif
```

## src/device_record.c
```c
#include "device_record.h"

void insertRec(ConnRec *connrec, DeviceRec devrec) {
	int idx = searchAddr(connrec, &devrec.addr);
	int key = irq_lock();
	if (idx != -1) {
		connrec->DevRec[idx].last_conn_timestamp = devrec.last_conn_timestamp;
		connrec->DevRec[idx].priority = devrec.priority;
		connrec->DevRec[idx].rssi = devrec.rssi;
	}
	else {
		if (connrec->NumofRec < NUM_MAX_RECORDS) {
			memcpy(&connrec->DevRec[connrec->NumofRec], &devrec, sizeof(DeviceRec));
			connrec->NumofRec++;
		}
		else {
			connrec->DevRec[connrec->earliest_idx] = devrec;
			memcpy(&connrec->DevRec[connrec->earliest_idx], &devrec, sizeof(DeviceRec));
		}
	}
	connrec->earliest_idx = getEarliest(connrec);
	irq_unlock(key);
}

uint8_t getEarliest(ConnRec *connrec) {
	int key = irq_lock();
	uint8_t idx = 0;
	int64_t min = INT64_MAX;
	for (int i = 0; i < connrec->NumofRec; i++) {
		if (connrec->DevRec[i].last_conn_timestamp < min) {
			min = connrec->DevRec[i].last_conn_timestamp;
			idx = i;
		}
	}
	return idx;
	irq_unlock(key);
}

int searchAddr(ConnRec *connrec, const bt_addr_le_t *addr) {
	int key = irq_lock();
	for (int i = 0; i < connrec->NumofRec; i++) {
		if (bt_addr_le_cmp(&connrec->DevRec[i].addr, addr) == 0) {
			irq_unlock(key);
			return i;
		}
	}
	irq_unlock(key);
	return -1;
}

int64_t getLastConnTimeStamp(ConnRec *connrec, const bt_addr_le_t *addr) {
	int idx = searchAddr(connrec, addr);
	if (idx == -1) {
		return INT64_MIN;
	}
	else {
		return connrec->DevRec[idx].last_conn_timestamp;
	}
}
```

## src/device_record.h
```c
#ifndef _DEV_REC_
#define _DEV_REC_

#include "ble_comms.h"

#define NUM_MAX_RECORDS 256 //MAX 256

typedef struct device_record {
	bt_addr_le_t addr;
	int64_t last_conn_timestamp;
	uint8_t battery_lvl;
	int8_t rssi;
	int64_t priority;
}DeviceRec;

typedef struct conn_record {
	DeviceRec DevRec[NUM_MAX_RECORDS];
	uint8_t NumofRec;
	uint8_t earliest_idx;
}ConnRec;

void insertRec(ConnRec *connrec, DeviceRec devrec);
uint8_t getEarliest(ConnRec *connrec);  //return the index of the earliest conn
int searchAddr(ConnRec *connrec, const bt_addr_le_t *addr);  //-1 if no record
int64_t getLastConnTimeStamp(ConnRec *connrec, const bt_addr_le_t *addr);  //INT64_MIN if no record


#endif
```

## src/main.h
```c
#ifndef _MAIN_H_
#define _MAIN_H_

#include <zephyr/types.h>
#include <stddef.h>
#include <stdint.h>
#include <errno.h>
#include <zephyr.h>
#include <sys/printk.h>
#include <sys/byteorder.h>
#include <power/reboot.h>

#include "ble_comms.h"

extern struct k_mutex discovering;
extern struct k_condvar wait_discovering_complete;
extern struct k_sem gatt_read_sem;

extern struct bt_gatt_dm_cb discover_all_cb;
extern struct bt_gatt_read_params gatt_read_params;
extern struct bt_gatt_write_params gatt_write_params;

extern ConnPQueue ConnPQ;
extern ConnRec ConnRC;

#endif
```
